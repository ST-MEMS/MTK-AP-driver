## Kconfig
```kconfig
config ST_LSM6DSO_IMU
	bool "STMicroelectronics LSM6DSO IMU"
	depends on I2C
        default n
	help
	  Say Y here if you have a STMicroelectronics LSM6DSO IMU
	  connected to your system.

	  If unsure, say N.
```

## LIS2DS12/Kconfig
```kconfig
config ST_LIS2DS12_ACCEL
	bool "STMicroelectronics LIS2DS12 Accelerometer"
	depends on I2C
        default n
	help
	  Say Y here if you have a STMicroelectronics LIS2DS12 Accelerometer
	  connected to your system.

	  If unsure, say N.
```

## LIS2HH12/Kconfig
```kconfig
config MTK_LIS2HH12
	bool "LIS2HH12 for MediaTek package"
        default n
	help
	  It support different accelerometer sensor.
          If this option is set,
	  it will support
          LIS2HH12 Accelerometer.
```

## LSM6DS3-C/Kconfig
```kconfig
config ST_LSM6DS3TRC_IMU
	bool "STMicroelectronics LSM6DS3TR-C IMU"
	depends on I2C
        default n
	help
	  Say Y here if you have a STMicroelectronics LSM6DS3TR-C IMU
	  connected to your system.

	  If unsure, say N.
```

## LSM6DS3/Kconfig
```kconfig
config ST_LSM6DS3_IMU
	bool "STMicroelectronics LSM6DS3 IMU"
	depends on I2C
        default n
	help
	  Say Y here if you have a STMicroelectronics LSM6DS3 IMU
	  connected to your system.

	  If unsure, say N.
```
